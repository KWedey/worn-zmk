## boards/shields/worn/Kconfig.defconfig
```kconfig
if SHIELD_WORN_LEFT

config ZMK_KEYBOARD_NAME
    default "Worn"

config ZMK_SPLIT_ROLE_CENTRAL
    default y

endif

if SHIELD_WORN_LEFT || SHIELD_WORN_RIGHT

config ZMK_SPLIT
    default y

endif
```
