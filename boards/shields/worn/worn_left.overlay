#include "worn.dtsi"

&kscan0 {
    col-gpios
        = <&pro_micro 2 GPIO_ACTIVE_LOW>
        , <&pro_micro 3 GPIO_ACTIVE_LOW>
        , <&pro_micro 4 GPIO_ACTIVE_LOW>
        , <&pro_micro 5 GPIO_ACTIVE_LOW>
        , <&pro_micro 6 GPIO_ACTIVE_LOW>
        , <&pro_micro 7 GPIO_ACTIVE_LOW>
        ;
};
